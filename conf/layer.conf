## conf/layer.conf
```bitbake
# layer.conf
BBPATH .= ":${LAYERDIR}"
BBFILES += "${LAYERDIR}/recipes-*/*/*.bb"

BBFILE_COLLECTIONS += "meta-agl-quiz"
BBFILE_PATTERN_meta-agl-quiz := "^${LAYERDIR}/"
BBFILE_PRIORITY_meta-agl-quiz = "6"

LAYERDEPENDS_meta-agl-quiz = "core"
LAYERSERIES_COMPAT_meta-agl-quiz = "nanbield scarthgap"
```
